## linux-4.19.9/drivers/exein_interface/Kconfig
```kconfig
config EXEIN_INTERFACE
        tristate "Exein userspace interface support"
        help
        This driver provides Exein proc interface
```

## linux-4.19.9/scripts/exein/Kconfig
```kconfig
config SECURITY_EXEIN
	bool "Exein rules the IT"
	depends on SECURITY
	default n
	help
	  This selects exein, bla bla bla
```

## linux-4.19.9/security/exein/Kconfig
```kconfig
config SECURITY_EXEIN
	bool "Exein Linux Security Module"
	depends on SECURITY
	default n
	help
	  This selects exein, bla bla bla

config SECURITY_EXEIN_RANDOMFOREST
        bool "Implement Machine learning engine using random forest"
        depends on SECURITY_EXEIN
        default n
        select SIGNATURE
        help
          Bla Bla.


config SECURITY_EXEIN_NEURALNETWORK
        bool "Implement Machine learning engine using Recurrent neural network"
        depends on SECURITY_EXEIN
        default n
        select SIGNATURE
        help
          Bla Bla.

config SECURITY_EXEIN_SQUEEZE
        bool "Optimization needed to squueze the LSM into small boxes"
        depends on SECURITY_EXEIN
        default n
        select SIGNATURE
        help
          Bla Bla.
```
